## build/Kconfig/arch/Kconfig.tmp
```kconfig
# Load Zephyr Arch Kconfig descriptions.
osource "/home/georg/zephyrworkspace/zephyr/arch/rx/Kconfig"
osource "/home/georg/zephyrworkspace/zephyr/arch/x86/Kconfig"
osource "/home/georg/zephyrworkspace/zephyr/arch/xtensa/Kconfig"
osource "/home/georg/zephyrworkspace/zephyr/arch/sparc/Kconfig"
osource "/home/georg/zephyrworkspace/zephyr/arch/riscv/Kconfig"
osource "/home/georg/zephyrworkspace/zephyr/arch/posix/Kconfig"
osource "/home/georg/zephyrworkspace/zephyr/arch/mips/Kconfig"
osource "/home/georg/zephyrworkspace/zephyr/arch/arm64/Kconfig"
osource "/home/georg/zephyrworkspace/zephyr/arch/arm/Kconfig"
osource "/home/georg/zephyrworkspace/zephyr/arch/arc/Kconfig"
```

## build/Kconfig/boards/Kconfig.defconfig.tmp
```kconfig
# Load Zephyr board defconfig descriptions.
osource "/home/georg/zephyrworkspace/zephyr/boards/digee/mcmd_stm32_g0b1cc/Kconfig.defconfig"
```

## build/Kconfig/boards/Kconfig.mcmd_stm32_g0b1cc.tmp
```kconfig
# Load board Kconfig descriptions.
osource "/home/georg/zephyrworkspace/zephyr/boards/digee/mcmd_stm32_g0b1cc/Kconfig.mcmd_stm32_g0b1cc"
```

## build/Kconfig/boards/Kconfig.sysbuild.tmp
```kconfig
# Load Sysbuild board Kconfig descriptions.
osource "/home/georg/zephyrworkspace/zephyr/boards/digee/mcmd_stm32_g0b1cc/Kconfig.sysbuild"
```

## build/Kconfig/soc/Kconfig
```kconfig
# Load Zephyr SoC Kconfig descriptions.
osource "/home/georg/zephyrworkspace/zephyr/soc/xlnx/zynqmp/Kconfig"
osource "/home/georg/zephyrworkspace/zephyr/soc/xlnx/zynq7000/Kconfig"
osource "/home/georg/zephyrworkspace/zephyr/soc/xlnx/versalnet/Kconfig"
osource "/home/georg/zephyrworkspace/zephyr/soc/xlnx/versal2/Kconfig"
osource "/home/georg/zephyrworkspace/zephyr/soc/xlnx/versal/Kconfig"
osource "/home/georg/zephyrworkspace/zephyr/soc/xen/Kconfig"
osource "/home/georg/zephyrworkspace/zephyr/soc/wch/ch32v/Kconfig"
osource "/home/georg/zephyrworkspace/zephyr/soc/ti/simplelink/Kconfig"
osource "/home/georg/zephyrworkspace/zephyr/soc/ti/mspm0/Kconfig"
osource "/home/georg/zephyrworkspace/zephyr/soc/ti/lm3s6965/Kconfig"
osource "/home/georg/zephyrworkspace/zephyr/soc/ti/k3/Kconfig"
osource "/home/georg/zephyrworkspace/zephyr/soc/telink/tlsr/Kconfig"
osource "/home/georg/zephyrworkspace/zephyr/soc/starfive/jh71xx/Kconfig"
osource "/home/georg/zephyrworkspace/zephyr/soc/st/stm32/Kconfig"
osource "/home/georg/zephyrworkspace/zephyr/soc/snps/qemu_arc/Kconfig"
osource "/home/georg/zephyrworkspace/zephyr/soc/snps/nsim/arc_v/Kconfig"
osource "/home/georg/zephyrworkspace/zephyr/soc/snps/nsim/arc_classic/Kconfig"
osource "/home/georg/zephyrworkspace/zephyr/soc/snps/hsdk4xd/Kconfig"
osource "/home/georg/zephyrworkspace/zephyr/soc/snps/hsdk/Kconfig"
osource "/home/georg/zephyrworkspace/zephyr/soc/snps/emsk/Kconfig"
osource "/home/georg/zephyrworkspace/zephyr/soc/snps/emsdp/Kconfig"
osource "/home/georg/zephyrworkspace/zephyr/soc/snps/arc_iot/Kconfig"
osource "/home/georg/zephyrworkspace/zephyr/soc/silabs/Kconfig"
osource "/home/georg/zephyrworkspace/zephyr/soc/sifli/sf32/Kconfig"
osource "/home/georg/zephyrworkspace/zephyr/soc/sifive/sifive_freedom/Kconfig"
osource "/home/georg/zephyrworkspace/zephyr/soc/sensry/Kconfig"
osource "/home/georg/zephyrworkspace/zephyr/soc/rockchip/Kconfig"
osource "/home/georg/zephyrworkspace/zephyr/soc/renode/riscv_virtual/Kconfig"
osource "/home/georg/zephyrworkspace/zephyr/soc/renode/cortex_r8_virtual/Kconfig"
osource "/home/georg/zephyrworkspace/zephyr/soc/renesas/smartbond/Kconfig"
osource "/home/georg/zephyrworkspace/zephyr/soc/renesas/rz/Kconfig"
osource "/home/georg/zephyrworkspace/zephyr/soc/renesas/rx/Kconfig"
osource "/home/georg/zephyrworkspace/zephyr/soc/renesas/rcar/Kconfig"
osource "/home/georg/zephyrworkspace/zephyr/soc/renesas/ra/Kconfig"
osource "/home/georg/zephyrworkspace/zephyr/soc/realtek/fingerprint/Kconfig"
osource "/home/georg/zephyrworkspace/zephyr/soc/realtek/ec/Kconfig"
osource "/home/georg/zephyrworkspace/zephyr/soc/realtek/ameba/Kconfig"
osource "/home/georg/zephyrworkspace/zephyr/soc/raspberrypi/rpi_pico/Kconfig"
osource "/home/georg/zephyrworkspace/zephyr/soc/quicklogic/eos_s3/Kconfig"
osource "/home/georg/zephyrworkspace/zephyr/soc/qemu/virt_riscv/Kconfig"
osource "/home/georg/zephyrworkspace/zephyr/soc/qemu/malta/Kconfig"
osource "/home/georg/zephyrworkspace/zephyr/soc/openisa/rv32m1/Kconfig"
osource "/home/georg/zephyrworkspace/zephyr/soc/openhwgroup/cva6/Kconfig"
osource "/home/georg/zephyrworkspace/zephyr/soc/oct/osd32mp15x/Kconfig"
osource "/home/georg/zephyrworkspace/zephyr/soc/nxp/s32/Kconfig"
osource "/home/georg/zephyrworkspace/zephyr/soc/nxp/rw/Kconfig"
osource "/home/georg/zephyrworkspace/zephyr/soc/nxp/mcx/Kconfig"
osource "/home/georg/zephyrworkspace/zephyr/soc/nxp/lpc/Kconfig"
osource "/home/georg/zephyrworkspace/zephyr/soc/nxp/layerscape/Kconfig"
osource "/home/georg/zephyrworkspace/zephyr/soc/nxp/kinetis/Kconfig"
osource "/home/georg/zephyrworkspace/zephyr/soc/nxp/imxrt/Kconfig"
osource "/home/georg/zephyrworkspace/zephyr/soc/nxp/imx/Kconfig"
osource "/home/georg/zephyrworkspace/zephyr/soc/nuvoton/numicro/Kconfig"
osource "/home/georg/zephyrworkspace/zephyr/soc/nuvoton/numaker/Kconfig"
osource "/home/georg/zephyrworkspace/zephyr/soc/nuvoton/npcx/Kconfig"
osource "/home/georg/zephyrworkspace/zephyr/soc/nuvoton/npcm/Kconfig"
osource "/home/georg/zephyrworkspace/zephyr/soc/nordic/Kconfig"
osource "/home/georg/zephyrworkspace/zephyr/soc/neorv32/Kconfig"
osource "/home/georg/zephyrworkspace/zephyr/soc/native/inf_clock/Kconfig"
osource "/home/georg/zephyrworkspace/zephyr/soc/microchip/sam/sama7/Kconfig"
osource "/home/georg/zephyrworkspace/zephyr/soc/microchip/sam/sam_d5x_e5x/Kconfig"
osource "/home/georg/zephyrworkspace/zephyr/soc/microchip/pic64/Kconfig"
osource "/home/georg/zephyrworkspace/zephyr/soc/microchip/pic32c/pic32cz_ca/Kconfig"
osource "/home/georg/zephyrworkspace/zephyr/soc/microchip/pic32c/pic32cx_sg/Kconfig"
osource "/home/georg/zephyrworkspace/zephyr/soc/microchip/pic32c/pic32cm_jh/Kconfig"
osource "/home/georg/zephyrworkspace/zephyr/soc/microchip/miv/Kconfig"
osource "/home/georg/zephyrworkspace/zephyr/soc/microchip/mec/Kconfig"
osource "/home/georg/zephyrworkspace/zephyr/soc/mediatek/mt8xxx/Kconfig"
osource "/home/georg/zephyrworkspace/zephyr/soc/lowrisc/opentitan/Kconfig"
osource "/home/georg/zephyrworkspace/zephyr/soc/litex/litex_vexriscv/Kconfig"
osource "/home/georg/zephyrworkspace/zephyr/soc/ite/ec/Kconfig"
osource "/home/georg/zephyrworkspace/zephyr/soc/intel/wildcat_lake/Kconfig"
osource "/home/georg/zephyrworkspace/zephyr/soc/intel/raptor_lake/Kconfig"
osource "/home/georg/zephyrworkspace/zephyr/soc/intel/panther_lake/Kconfig"
osource "/home/georg/zephyrworkspace/zephyr/soc/intel/lakemont/Kconfig"
osource "/home/georg/zephyrworkspace/zephyr/soc/intel/intel_socfpga_std/Kconfig"
osource "/home/georg/zephyrworkspace/zephyr/soc/intel/intel_socfpga/Kconfig"
osource "/home/georg/zephyrworkspace/zephyr/soc/intel/intel_niosv/Kconfig"
osource "/home/georg/zephyrworkspace/zephyr/soc/intel/intel_ish/Kconfig"
osource "/home/georg/zephyrworkspace/zephyr/soc/intel/intel_adsp/Kconfig"
osource "/home/georg/zephyrworkspace/zephyr/soc/intel/elkhart_lake/Kconfig"
osource "/home/georg/zephyrworkspace/zephyr/soc/intel/atom/Kconfig"
osource "/home/georg/zephyrworkspace/zephyr/soc/intel/apollo_lake/Kconfig"
osource "/home/georg/zephyrworkspace/zephyr/soc/intel/alder_lake/Kconfig"
osource "/home/georg/zephyrworkspace/zephyr/soc/infineon/psoc4/Kconfig"
osource "/home/georg/zephyrworkspace/zephyr/soc/infineon/edge/Kconfig"
osource "/home/georg/zephyrworkspace/zephyr/soc/infineon/cat3/Kconfig"
osource "/home/georg/zephyrworkspace/zephyr/soc/infineon/cat1c/Kconfig"
osource "/home/georg/zephyrworkspace/zephyr/soc/infineon/cat1b/Kconfig"
osource "/home/georg/zephyrworkspace/zephyr/soc/infineon/cat1a/Kconfig"
osource "/home/georg/zephyrworkspace/zephyr/soc/gd/gd32/Kconfig"
osource "/home/georg/zephyrworkspace/zephyr/soc/gaisler/leon3/Kconfig"
osource "/home/georg/zephyrworkspace/zephyr/soc/gaisler/gr716a/Kconfig"
osource "/home/georg/zephyrworkspace/zephyr/soc/focaltech/Kconfig"
osource "/home/georg/zephyrworkspace/zephyr/soc/espressif/Kconfig"
osource "/home/georg/zephyrworkspace/zephyr/soc/ene/kb1200/Kconfig"
osource "/home/georg/zephyrworkspace/zephyr/soc/ene/kb106x/Kconfig"
osource "/home/georg/zephyrworkspace/zephyr/soc/elan/em32f967/Kconfig"
osource "/home/georg/zephyrworkspace/zephyr/soc/egis/Kconfig"
osource "/home/georg/zephyrworkspace/zephyr/soc/efinix/sapphire/Kconfig"
osource "/home/georg/zephyrworkspace/zephyr/soc/cdns/xtensa_sample_controller/Kconfig"
osource "/home/georg/zephyrworkspace/zephyr/soc/cdns/sample_controller32/Kconfig"
osource "/home/georg/zephyrworkspace/zephyr/soc/cdns/dc233c/Kconfig"
osource "/home/georg/zephyrworkspace/zephyr/soc/brcm/bcmvk/Kconfig"
osource "/home/georg/zephyrworkspace/zephyr/soc/brcm/bcm2712/Kconfig"
osource "/home/georg/zephyrworkspace/zephyr/soc/brcm/bcm2711/Kconfig"
osource "/home/georg/zephyrworkspace/zephyr/soc/blackberry/qnxhv_vm/Kconfig"
osource "/home/georg/zephyrworkspace/zephyr/soc/bflb/Kconfig"
osource "/home/georg/zephyrworkspace/zephyr/soc/atmel/sam0/Kconfig"
osource "/home/georg/zephyrworkspace/zephyr/soc/atmel/sam/Kconfig"
osource "/home/georg/zephyrworkspace/zephyr/soc/aspeed/Kconfig"
osource "/home/georg/zephyrworkspace/zephyr/soc/arm/Kconfig"
osource "/home/georg/zephyrworkspace/zephyr/soc/arm/beetle/Kconfig"
osource "/home/georg/zephyrworkspace/zephyr/soc/antmicro/myra/Kconfig"
osource "/home/georg/zephyrworkspace/zephyr/soc/andestech/Kconfig"
osource "/home/georg/zephyrworkspace/zephyr/soc/amd/acp_6_0/Kconfig"
osource "/home/georg/zephyrworkspace/zephyr/soc/ambiq/Kconfig"
osource "/home/georg/zephyrworkspace/zephyr/soc/allwinner/sun8i_h3/Kconfig"
osource "/home/georg/zephyrworkspace/zephyr/soc/aesc/Kconfig"
osource "/home/georg/zephyrworkspace/zephyr/soc/adi/max32/Kconfig"
```
